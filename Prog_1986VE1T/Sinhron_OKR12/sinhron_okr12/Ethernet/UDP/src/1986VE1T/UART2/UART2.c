#ifndef __UART2_c__
#define __UART2_c__

#include "opora.h"
#include "UART2.h"

//--- UART configuration ---
void UART2Config()
{
#ifdef REVISION_2
	UART2->IBRD = 0x000D;	//13// speed of UART1 = 57600 bit/s, Целая часть делителя скорости обмена данными
	UART2->FBRD = 0x0024;	//36
#else
	UART2->IBRD = 0x000D;	//13
	UART2->FBRD = 0x0001;	//36
#endif	//REVISION_2
	UART2->LCR_H = 0x0060;// Регистр управления линией 8-bits word, FIFO enable, parity disable, 1 stop bit
	
// UART2->LCR_H - Регистр управления линией
// ╔═════════╦════════════════╦════════════════════════════════════════════════════════════════════════════════════╗
// ║ 	 Биты  ║ Поле           ║                 Назначение                                                         ║
// ╠═════════╬════════════════╬════════════════════════════════════════════════════════════════════════════════════╣
// ║  15..8  ║      -         ║ Зарезервировано. Не модифицировать. При чтении возвращаются нули                   ║
// ╟─────────╫────────────────╫────────────────────────────────────────────────────────────────────────────────────╢
// ║    7    ║     SPS        ║ Передача бита чётности с фиксированным значением.                                  ║
// ║         ║                ║ 0 - запрещена                                                                      ║
// ║         ║                ║ 1 - на месте бита чётности передаётся инверсное значение бита EPS, оно же          ║
// ║         ║                ║     проверяется при приёме данных. (При EPS = 0 на месте бита чётности передаётся  ║
// ║         ║                ║     Значение бита SPS  не играет роли в случае, если битом PEN формирование и      ║
// ║         ║                ║     проверка бита чётности запрещено.                                              ║
// ╟─────────╫────────────────╫────────────────────────────────────────────────────────────────────────────────────╢
// ║  6..5   ║    WLEN        ║ Длина слова - количество передаваемых или принимаемых информационных бит в кадре:  ║
// ║         ║                ║ 00 - 5 бит,                                                                        ║
// ║         ║                ║ 01 - 6 бит,                                                                        ║
// ║         ║                ║ 10 - 7 бит,                                                                        ║
// ║         ║                ║ 11 - 8 бит,                                                                        ║
// ╟─────────╫────────────────╫────────────────────────────────────────────────────────────────────────────────────╢
// ║    4    ║    FEN         ║ Разрешение работы буфера FIFO приёмника и передатчика                              ║
// ║         ║                ║ 0 - запрещено                                                                      ║
// ║         ║                ║ 1 - разрешено                                                                      ║
// ╟─────────╫────────────────╫────────────────────────────────────────────────────────────────────────────────────╢
// ║    3    ║    STP2        ║ Режим передачи двух стоповых бит                                                   ║
// ║         ║                ║ 0 - один стоповый бит                                                              ║
// ║         ║                ║ 1 - два стоповых бита                                                              ║
// ║         ║                ║ Приёмник не проверяет наличие дополнительного стопового бита в кадре.              ║
// ╟─────────╫────────────────╫────────────────────────────────────────────────────────────────────────────────────╢
// ║    2    ║    EPS         ║ Чётность/нечётность                                                                ║
// ║         ║                ║ 0 - бит чётности дополняет количество единиц в информационной части кадра до нечёт.║
// ║         ║                ║ 1 - бит чётности дополняет количество единиц в информационной части кадра до чёт.  ║
// ║         ║                ║ Значение бита EPS не играет роли в том случае, если битом PEN формирование и       ║
// ║         ║                ║ проверка бита чётности запрещено.                                                  ║
// ╟─────────╫────────────────╫────────────────────────────────────────────────────────────────────────────────────╢
// ║    1    ║    PEN         ║ Разрешение проверки чётности.                                                      ║
// ║         ║                ║ 0 - кадр не содержит бита чётности.                                                ║
// ║         ║                ║ 1 - бит чётности передаётся в кадре и проверяется при приёме данных                ║
// ╟─────────╫────────────────╫────────────────────────────────────────────────────────────────────────────────────╢
// ║    0    ║    BRK         ║ Разрыв линии                                                                       ║
// ║         ║                ║ Если этот бит установлен в 1, то по завершении передачи текущего символа на выходе ║
// ║         ║                ║ линии UART_TXD устанавливается низкий уровень сигнала. Для правильного выполнения  ║
// ║         ║                ║ этой операции программное обеспечение должно обеспечить передачу сигнала разрыва в ║
// ║         ║                ║ течение, как минимум, времени передачи двух информационных кадров. В нормальном    ║
// ║         ║                ║ режиме функционирования бит должен быть установлен в 0                             ║
// ╚═════════╩════════════════╩════════════════════════════════════════════════════════════════════════════════════╝
    UART2->ICR =0x10;		//reset Rx interrupt
	UART2->IMSC=0x10;		//Rx interrupt enable
	UART2->CR = 0x0301;     // Регистр управления. UART2, Tx, Rx enable
	
// UART2->CR - Регистр управления
// ╔═════════╦════════════════╦════════════════════════════════════════════════════════════════════════════════════╗
// ║ 	 Биты  ║ Поле           ║                 Назначение                                                         ║
// ╠═════════╬════════════════╬════════════════════════════════════════════════════════════════════════════════════╣
// ║   15    ║    CTSEn       ║ Разрешение управления потоком данных по CTS.                                       ║
// ║         ║                ║ 1 - разрешено, данные передаются в линию только при активном значении сигнала      ║
// ║         ║                ║     nUARTCTS.                                                                      ║
// ║         ║                ║ 0 - запрещено.                                                                     ║
// ╟─────────╫────────────────╫────────────────────────────────────────────────────────────────────────────────────╢
// ║   14    ║    RTSEn       ║ Разрешение управления потоком данных по RTS.                                       ║
// ║         ║                ║ 1 - разрешено, запрос данных от внешнего устройства осуществляется только при      ║
// ║         ║                ║     наличии свободного места в буфере FIFO приёмника.                              ║
// ║         ║                ║ 0 - запрещено.                                                                     ║
// ╟─────────╫────────────────╫────────────────────────────────────────────────────────────────────────────────────╢
// ║   13    ║    Out2        ║ Инверсия сигнала на линии состояния модема nUARTOut2. В режиме оконечного оборудо- ║
// ║         ║                ║ вания (DTE) эта линия может использоваться в качестве линии "сигнал вызова" (RI).  ║
// ║         ║                ║ 1 - сигнал разрешён                                                                ║
// ║         ║                ║ 0 - сигнал запрещён                                                                ║
// ╟─────────╫────────────────╫────────────────────────────────────────────────────────────────────────────────────╢
// ║   12    ║    Out1        ║ Инверсия сигнала на линии состояния модема nUARTOut1. В режиме оконечного оборудо- ║
// ║         ║                ║ вания (DTE) эта линия может использоваться в качестве линии "обнаружен информацион-║
// ║         ║                ║ ный сигнал" (DCD)                                                                  ║
// ║         ║                ║ 1 - сигнал разрешён                                                                ║
// ║         ║                ║ 0 - сигнал запрещён                                                                ║
// ╟─────────╫────────────────╫────────────────────────────────────────────────────────────────────────────────────╢
// ║   11    ║    RTS         ║ Инверсия сигнала на линии состояния модема nUARTRTS.                               ║
// ║         ║                ║ 1 - сигнал разрешён                                                                ║
// ║         ║                ║ 0 - сигнал запрещён                                                                ║
// ╟─────────╫────────────────╫────────────────────────────────────────────────────────────────────────────────────╢
// ║   10    ║    DTR         ║ Инверсия сигнала на линии состояния модема nUARTRTR.                               ║
// ║         ║                ║ 1 - сигнал разрешён                                                                ║
// ║         ║                ║ 0 - сигнал запрещён                                                                ║
// ╟─────────╫────────────────╫────────────────────────────────────────────────────────────────────────────────────╢
// ║   9     ║    RXE         ║ Разрешение приёма                                                                  ║
// ║         ║                ║ 1 - работа приёмника разрешена. Приём данных осуществляется либо по интерфейсу     ║
// ║         ║                ║     асинхронного последовательного обмена, либо по интерфейсу ИК обмена SIR, в     ║
// ║         ║                ║     зависимости от значения бита SIREN.                                            ║
// ║         ║                ║ 0 - работа приёмника запрещена.                                                    ║
// ║         ║                ║     В случае перевода приёмопередатчика в запрещённое состояние в ходе приёма дан- ║
// ║         ║                ║     ных, он завершает приём текущего символа перед остановкой.                     ║
// ╟─────────╫────────────────╫────────────────────────────────────────────────────────────────────────────────────╢
// ║   8     ║    TXE         ║ Разрешение передачи                                                                ║
// ║         ║                ║ 1 - работа передатчика разрешена. Передача данных осуществляется либо по интерфейсу║
// ║         ║                ║     асинхронного последовательного обмена, либо по интерфейсу ИК обмена SIR, в     ║
// ║         ║                ║     зависимости от значения бита SIREN.                                            ║
// ║         ║                ║ 0 - работа передатчика запрещена.                                                  ║
// ║         ║                ║     В случае перевода приёмопередатчика в запрещённое состояние в ходе передачи    ║
// ║         ║                ║     данных, он завершает передачу текущего символа перед остановкой.               ║
// ╟─────────╫────────────────╫────────────────────────────────────────────────────────────────────────────────────╢
// ║   7     ║    LBE         ║ Режим тестирования по шлейфу                                                       ║
// ║         ║                ║ 1 - шлейф разрешён.                                                                ║
// ║         ║                ║ 0 - запрещён.                                                                      ║
// ║         ║                ║ В режиме разрешённого шлейфа:                                                      ║
// ║         ║                ║ Если установлены бит SIREN = 1 и бит регистра управления тестированием TCR         ║
// ║         ║                ║ SIRTEST = 1, то сигнал с выхода кодека nSIROUT инвертируется и подаётся на вход    ║
// ║         ║                ║ кодека SIRIN. Бит SIRTEST устанавливается в 1 для того, чтобы вывести устройство   ║
// ║         ║                ║ из полудуплексного режима, характерного для интерфейса SIR. После окончания тес-   ║
// ║         ║                ║ тирования по шлейфу бит SIRTEST должен быть установлен в 0.                        ║
// ║         ║                ║ Если бит SIRTEST = 0, то выходная линия передатчика UART_TXDx коммутируется на вход║
// ║         ║                ║ приёмника UART_RXDx.                                                               ║
// ║         ║                ║ Как в режиме SIR, так и в режиме UART, выходные линии состояния модема коммутируют-║
// ║         ║                ║ ся на соответствующие входные линии.                                               ║
// ║         ║                ║ После сброса бит устанавливается в 0.                                              ║
// ╟─────────╫────────────────╫────────────────────────────────────────────────────────────────────────────────────╢
// ║   6..3  ║                ║ Резерв. Не модифицируйте. При чтении выдаются нули.                                ║
// ╟─────────╫────────────────╫────────────────────────────────────────────────────────────────────────────────────╢
// ║   2     ║    SIRLP       ║ Выбор режима ИК обмена с пониженным энергопотреблением.                            ║
// ║         ║                ║ 1 - длительность импульсов данных равна трём тактам сигнала IrLPBaud16 вне зависи- ║
// ║         ║                ║     мости от выбранной скорости передачи данных. Выбор этого режима снижает энерго-║
// ║         ║                ║     потребление, однаком может привести к уменьшению дальности связи.              ║
// ║         ║                ║ 0 - длительность импульсов данных равна 3/16 длительности передачи бита.           ║
// ╟─────────╫────────────────╫────────────────────────────────────────────────────────────────────────────────────╢
// ║   1     ║    SIREN       ║ Разрешение работы кодека ИК передачи данных IrDA SIR:                              ║
// ║         ║                ║ 1 - разрешена работа кодека ИК. Данные передаются на выход nSIROUT и принимаются с ║
// ║         ║                ║     входа SIRIN. Линия UART_TXDx находится в высоком состоянии. Данные на входе    ║
// ║         ║                ║     UART_RXDx и линиях состояния модема не обрабатываются.                         ║
// ║         ║                ║     В случае, если UARTEN = 0 значение бита не играет роли.                        ║
// ║         ║                ║ 0 - запрещён. Сигнал nSIROUT находится в низком состоянии, данные на входе SIRIN   ║
// ║         ║                ║     не обрабатываются.                                                             ║
// ╟─────────╫────────────────╫────────────────────────────────────────────────────────────────────────────────────╢
// ║   0     ║    UARTEN      ║ Разрешение работы приёмопередатчика.                                               ║
// ║         ║                ║ 0 - работа запрещена. Перед остановкой завершается приём и/или передача обрабаты-  ║
// ║         ║                ║     ваемого в текущий момент символа.                                              ║
// ║         ║                ║ 1 - работа разрешена. Производится обмен данными либо по линиям асинхронного об-   ║
// ║         ║                ║     мена, либо по линиям ИК обмена SIR, в зависимости от сосояния бита SIREN.      ║
// ╚═════════╩════════════════╩════════════════════════════════════════════════════════════════════════════════════╝
}


void zputc2 (unsigned long c) 
{
	while((UART2->FR&(1<<5)) == (1<<5));	//wait until FIFO Tx full
	UART2->DR = c; //Передача данных
	while((UART2->FR&(1<<3)) == (1<<3));	//wait until Tx transmit data
}

 void zputs2(unsigned char *s, unsigned l)
{
      unsigned i;
      for (i=0;i<l;i++) {zputc2 ((s[i]));}
}


void sendT2 (unsigned char * s)

 {
       zputs2(s,leng(s));

 }


#endif // __UART2_c__
