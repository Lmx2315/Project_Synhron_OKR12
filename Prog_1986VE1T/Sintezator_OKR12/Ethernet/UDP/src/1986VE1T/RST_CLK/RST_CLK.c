#ifndef __RST_CLK_c__
#define __RST_CLK_c__

#include "opora.h"
#include "RST_CLK.h"

#define REVISION_2

#define HSE2_OSCILLATOR

#define SPEED_100M

//--- Clock configuration ---
void RST_CLKConfig(void)
{
	uint32_t temp;
	RST_CLK->PER_CLOCK |= (1 << 27);				//BKP Clock enable
// PER_CLOCK - Регистр управления тактовой частотой периферийных блоков
// ╔═════════╦══════════════╦════════════════════════════════════════════════════════════════════════════════════╗
// ║ 	 Биты  ║  Поле        ║                 Назначение                                                         ║
// ╠═════════╬══════════════╬════════════════════════════════════════════════════════════════════════════════════╣
// ║   31    ║  PCLKEN[31]  ║ SPI3                                                                               ║
// ║   30    ║  PCLKEN[30]  ║ EXT_BUS_CNTRL                                                                      ║
// ║   29    ║  PCLKEN[29]  ║ PORTF                                                                              ║
// ║   28    ║  PCLKEN[28]  ║ ARINC429T                                                                          ║
// ║   27    ║  PCLKEN[27]  ║ BKP                                                                                ║
// ║   26    ║  PCLKEN[26]  ║ ARINC429R                                                                          ║
// ║   25    ║  PCLKEN[25]  ║ PORTE                                                                              ║
// ║   24    ║  PCLKEN[24]  ║ PORTD                                                                              ║
// ║   23    ║  PCLKEN[23]  ║ PORTC                                                                              ║
// ║   22    ║  PCLKEN[22]  ║ PORTB                                                                              ║
// ║   21    ║  PCLKEN[21]  ║ PORTA                                                                              ║
// ║   20    ║  PCLKEN[20]  ║ SPI2                                                                               ║
// ║   19    ║  PCLKEN[19]  ║ TIMER4                                                                             ║
// ║   18    ║  PCLKEN[18]  ║ DAC                                                                                ║
// ║   17    ║  PCLKEN[17]  ║ ADC                                                                                ║
// ║   16    ║  PCLKEN[16]  ║ TIMER3                                                                             ║
// ║   15    ║  PCLKEN[15]  ║ TIMER2                                                                             ║
// ║   14    ║  PCLKEN[14]  ║ TIMER1                                                                             ║
// ║   13    ║  PCLKEN[13]  ║ IWDT                                                                               ║
// ║   12    ║  PCLKEN[12]  ║ WWDT                                                                               ║
// ║   11    ║  PCLKEN[11]  ║ POWER                                                                              ║
// ║   10    ║  PCLKEN[10]  ║ MIL_STD-1553B2                                                                     ║
// ║    9    ║  PCLKEN[9]   ║ MIL_STD-1553B1                                                                     ║
// ║    8    ║  PCLKEN[8]   ║ SPI1                                                                               ║
// ║    7    ║  PCLKEN[7]   ║ UART2                                                                              ║
// ║    6    ║  PCLKEN[6]   ║ UART1                                                                              ║
// ║    5    ║  PCLKEN[5]   ║ DMA                                                                                ║
// ║    4    ║  PCLKEN[4]   ║ RST_CLK                                                                            ║
// ║    3    ║  PCLKEN[3]   ║ EEPROM_CNTRL                                                                       ║
// ║    2    ║  PCLKEN[2]   ║ USB                                                                                ║
// ║    1    ║  PCLKEN[1]   ║ CAN2                                                                               ║
// ║    0    ║  PCLKEN[0]   ║ CAN1                                                                               ║
// ╚═════════╩══════════════╩════════════════════════════════════════════════════════════════════════════════════╝	
	temp = BKP->REG_0E;
	temp &= 0xFFFFFFC0;
	BKP->REG_0E = temp | (7 << 3) | 7;				// SelectRI = 0x7, LOW = 0x7; (for core frequency more then 80 MHz);
// BKP->REG_0E -  Регистр управления линией
// ╔═════════╦════════════════╦════════════════════════════════════════════════════════════════════════════════════╗
// ║   Биты  ║ Поле           ║                 Назначение                                                         ║
// ╠═════════╬════════════════╬════════════════════════════════════════════════════════════════════════════════════╣
// ║  31..16 ║      -         ║ Зарезервировано                                                                    ║
// ╟─────────╫────────────────╫────────────────────────────────────────────────────────────────────────────────────╢
// ║    15   ║    ilimen      ║ Бит разрешения защиты ограничения регулятора по току 150 мА                        ║
// ║         ║                ║ 1 - разрешено                                                                      ║
// ║         ║                ║ 0 - запрещено                                                                      ║
// ╟─────────╫────────────────╫────────────────────────────────────────────────────────────────────────────────────╢
// ║    14   ║      -         ║ Зарезервировано                                                                    ║
// ╟─────────╫────────────────╫────────────────────────────────────────────────────────────────────────────────────╢
// ║  13..12 ║    Trim[4:3]   ║ Коэффициент настройки опорного напряжения регулятора                               ║
// ║         ║                ║ 00 - 1.8 В                                                                         ║
// ║         ║                ║ 01 - 1.6 В                                                                         ║
// ║         ║                ║ 10 - 1.4 В                                                                         ║
// ║         ║                ║ 11 - 1.2 В                                                                         ║
// ╟─────────╫────────────────╫────────────────────────────────────────────────────────────────────────────────────╢
// ║    11   ║    FPOR        ║ Флаг срабатывания POR                                                              ║
// ║         ║                ║ Устанавливается в 1 загрузочным ПЗУ после сброса по питанию, при сбросе по питанию ║
// ║         ║                ║ устанавливается в 0. Служит для анализа загрузочным ПЗУ, что сейчас идёт выполнение║
// ║         ║                ║ программы после системного или программного сброса, либо после сброса по питанию.  ║
// ╟─────────╫────────────────╫────────────────────────────────────────────────────────────────────────────────────╢
// ║  10..8  ║    Trim[2:0]   ║ Коэффициент настройки опорного напряжения встроенного регулятора напряжения Ducc.  ║
// ║         ║                ║ С помощью Trim осуществляется подстройка напряжения Ducc.                          ║
// ║         ║                ║ 000 - Ducc + 0,10 В - значение по умолчанию.                                       ║
// ║         ║                ║ 001 - Ducc + 0,06 В                                                                ║
// ║         ║                ║ 010 - Ducc + 0,04 В                                                                ║
// ║         ║                ║ 011 - Ducc + 0,01 В                                                                ║
// ║         ║                ║ 100 - Ducc - 0,10 В                                                                ║
// ║         ║                ║ 101 - Ducc - 0,04 В                                                                ║
// ║         ║                ║ 110 - Ducc - 0,06 В                                                                ║
// ║         ║                ║ 111 - Ducc - 0,10 В                                                                ║
// ╟─────────╫────────────────╫────────────────────────────────────────────────────────────────────────────────────╢
// ║    7    ║                ║ Зарезервировано                                                                    ║
// ╟─────────╫────────────────╫────────────────────────────────────────────────────────────────────────────────────╢
// ║    6    ║    Stand_Alone ║ 1 - выбор режима StandAlone                                                        ║
// ║         ║                ║ 0 - обычный режим работы                                                           ║
// ╟─────────╫────────────────╫────────────────────────────────────────────────────────────────────────────────────╢
// ║  5..3   ║  SelectRI[2:0] ║ Выбор дополнительной нагрузки для регулятора 1.8 В                                 ║
// ║         ║                ║ 000 - ~6 кОм (дополнительный ток потребления 300 мкА)                              ║
// ║         ║                ║ 001 - ~270 кОм (дополнительный ток потребления 6,6 мкА)                            ║
// ║         ║                ║ 010 - ~90 кОм (дополнительный ток потребления 20 мкА)                              ║
// ║         ║                ║ 011 - ~24 кОм (дополнительный ток потребления 80 мкА)                              ║
// ║         ║                ║ 100 - ~900 кОм (собственное потребление 2 мкА)                                     ║
// ║         ║                ║ 101 - ~2 кОм (дополнительный ток потребления 900 мкА)                              ║
// ║         ║                ║ 110 - ~400 Ом (дополнительный ток потребления 4,4 мА)                              ║
// ║         ║                ║ 111 - ~100 Ом (дополнительный ток потребления 19 мА)                               ║
// ╟─────────╫────────────────╫────────────────────────────────────────────────────────────────────────────────────╢
// ║  2..0   ║    LOW[2:0]    ║ Выбор режима работы регулятора 1.8 В                                               ║
// ║         ║                ║ Значение LOW должно совпадать с значением SelectRI и выставляться в зависимости от ║
// ║         ║                ║ тактовой частоты микроконтроллера                                                  ║
// ║         ║                ║ 000 - Частота до 10 МГц                                                            ║
// ║         ║                ║ 001 - Частота до 200 кГц                                                           ║
// ║         ║                ║ 010 - Частота до 500 кГц                                                           ║
// ║         ║                ║ 011 - Частота до 1 МГц                                                             ║
// ║         ║                ║ 100 - При выключении всех генераторов                                              ║
// ║         ║                ║ 101 - Частота до 40 МГц                                                            ║
// ║         ║                ║ 110 - Частота до 80 МГц                                                            ║
// ║         ║                ║ 111 - Частота более 80 МГц                                                         ║
// ╚═════════╩════════════════╩════════════════════════════════════════════════════════════════════════════════════╝

#ifdef REVISION_2

#ifdef HSE2_OSCILLATOR
	RST_CLK->HS_CONTROL=0x00000005;					//HSE On, Oscillator mode; HSE2 On, Oscillator mode

// HS_CONTROL - Регистр управления высокочастотным генератором и осциллятором
// ╔═════════╦══════════════╦════════════════════════════════════════════════════════════════════════════════════╗
// ║ 	 Биты  ║ Поле         ║                 Назначение                                                         ║
// ╠═════════╬══════════════╬════════════════════════════════════════════════════════════════════════════════════╣
// ║  31..4  ║      -       ║ Зарезервировано                                                                    ║
// ╟─────────╫──────────────╫────────────────────────────────────────────────────────────────────────────────────╢
// ║    3    ║  HSEBYP2     ║ Бит управления HSE2 осциллятором с ревизии 2                                       ║
// ║         ║              ║ 0 - режим осциллятора                                                              ║
// ║         ║              ║ 1 - режим внешнего генератора                                                      ║
// ╟─────────╫──────────────╫────────────────────────────────────────────────────────────────────────────────────╢
// ║    2    ║  HSEON2      ║ Бит управления HSE2 осциллятором с ревизии 2                                       ║
// ║         ║              ║ 0 - выключен                                                                       ║
// ║         ║              ║ 1 - включен                                                                        ║
// ╟─────────╫──────────────╫────────────────────────────────────────────────────────────────────────────────────╢
// ║    1    ║  HSEBYP      ║ Бит управления HSE осциллятором с ревизии                                          ║
// ║         ║              ║ 0 - режим осциллятора                                                              ║
// ║         ║              ║ 1 - режим внешнего генератора                                                      ║
// ╟─────────╫──────────────╫────────────────────────────────────────────────────────────────────────────────────╢
// ║    0    ║  HSEON       ║ Бит управления HSE осциллятором с ревизии                                          ║
// ║         ║              ║ 0 - выключен                                                                       ║
// ║         ║              ║ 1 - включен                                                                        ║
// ╚═════════╩══════════════╩════════════════════════════════════════════════════════════════════════════════════╝	
#else
	RST_CLK->HS_CONTROL=0x0000000D;					//HSE On, Oscillator mode; HSE2 On, Generator mode
#endif	// HSE2_OSCILLATOR

	while((RST_CLK->CLOCK_STATUS&0x0C)!=0x0C);		//Wait until HSE and HSE2 not ready
// CLOCK_STATUS - Регистр состояния блока управления тактовой частотой.
// ╔═════════╦══════════════╦════════════════════════════════════════════════════════════════════════════════════╗
// ║ 	 Биты  ║ Поле         ║                 Назначение                                                         ║
// ╠═════════╬══════════════╬════════════════════════════════════════════════════════════════════════════════════╣
// ║  31..4  ║      -       ║ Зарезервировано                                                                    ║
// ╟─────────╫──────────────╫────────────────────────────────────────────────────────────────────────────────────╢
// ║    3    ║  HSERDY2     ║ Флаг выхода в рабочий режим осциллятора HSE2                                       ║
// ║         ║              ║ 0 - осциллятор не запущен или не стабилен.                                         ║
// ║         ║              ║ 1 - осциллятор запущен и стабилен.                                                 ║
// ╟─────────╫──────────────╫────────────────────────────────────────────────────────────────────────────────────╢
// ║    2    ║  HSERDY      ║ Флаг выхода в рабочий режим осциллятора HSE                                        ║
// ║         ║              ║ 0 - осциллятор не запущен или не стабилен.                                         ║
// ║         ║              ║ 1 - осциллятор запущен и стабилен.                                                 ║
// ╟─────────╫──────────────╫────────────────────────────────────────────────────────────────────────────────────╢
// ║    1    ║  PLLCPURDY   ║ Флаг выхода в рабочий режим CPU PLL                                                ║
// ║         ║              ║ 0 - PLL не запущена или не стабильна                                               ║
// ║         ║              ║ 1 - PLL запущена и стабильна                                                       ║
// ╟─────────╫──────────────╫────────────────────────────────────────────────────────────────────────────────────╢
// ║    0    ║  PLLUSBRDY   ║ Флаг выхода в рабочий режим USB PLL                                                ║
// ║         ║              ║ 0 - PLL не запущена или не стабильна                                               ║
// ║         ║              ║ 1 - PLL запущена и стабильна                                                       ║
// ╚═════════╩══════════════╩════════════════════════════════════════════════════════════════════════════════════╝	

//----Биты выбора источника для CPU_C1 :  11 – CPU_C1 = HSE/2 (8MHz) ---
RST_CLK->CPU_CLOCK |= (1<<0); //установка еденицы
RST_CLK->CPU_CLOCK |= (1<<1); //установка нуля
//----------------------------------------------------------------------
// CPU_CLOCK - Регистр управления тактовой частотой процессорного ядра 
// ╔═════════╦══════════════╦════════════════════════════════════════════════════════════════════════════════════╗
// ║ 	 Биты  ║ Поле         ║                 Назначение                                                         ║
// ╠═════════╬══════════════╬════════════════════════════════════════════════════════════════════════════════════╣
// ║  31..10 ║      -       ║ Зарезервировано                                                                    ║
// ╟─────────╫──────────────╫────────────────────────────────────────────────────────────────────────────────────╢
// ║   9..8  ║ HCLKSEL[1:0] ║ Биты выбора источникля HCLK                                                        ║
// ║         ║              ║ 00 - HSI                                                                           ║
// ║         ║              ║ 01 - CPU_C3                                                                        ║
// ║         ║              ║ 10 - LSE                                                                           ║
// ║         ║              ║ 11 - LSI                                                                           ║
// ╟─────────╫──────────────╫────────────────────────────────────────────────────────────────────────────────────╢
// ║   7..4  ║ CPUC3SEL[3:0]║ Биты выбора делителя для CPU_C3                                                    ║
// ║         ║              ║ 0xxx - CPU_C3 = CPU_C2;                                                            ║
// ║         ║              ║ 1000 - CPU_C3 = CPU_C2/2;                                                          ║
// ║         ║              ║ 1001 - CPU_C3 = CPU_C2/4;                                                          ║
// ║         ║              ║ 1010 - CPU_C3 = CPU_C2/8;                                                          ║
// ║         ║              ║ ...                                                                                ║
// ║         ║              ║ 1010 - CPU_C3 = CPU_C2/256                                                         ║
// ╟─────────╫──────────────╫────────────────────────────────────────────────────────────────────────────────────╢
// ║    3    ║      -       ║ Зарезервировано                                                                    ║
// ╟─────────╫──────────────╫────────────────────────────────────────────────────────────────────────────────────╢
// ║    2    ║ CPUC2SEL     ║ Биты выбора источника для CPU_C2                                                   ║
// ║         ║              ║ 0 - CPU_C1                                                                         ║
// ║         ║              ║ 1 - PLLCPUo                                                                        ║
// ╟─────────╫──────────────╫────────────────────────────────────────────────────────────────────────────────────╢
// ║   1..0  ║ CPUC1SEL[1:0]║ Биты выбора источника для CPU_C1                                                   ║
// ║         ║              ║ 00 -  HSI                                                                          ║
// ║         ║              ║ 01 -  HSI/2                                                                        ║
// ║         ║              ║ 10 -  HSE                                                                          ║
// ║         ║              ║ 11 -  HSE/2                                                                        ║
// ╚═════════╩══════════════╩════════════════════════════════════════════════════════════════════════════════════╝	

	RST_CLK->PLL_CONTROL=(11<<8)|(1<<2);			//PLL CPU On, PLL_MULL=11
// PLL_CONTROL - Регистр управления блоками умножения тактовой частоты
// ╔═════════╦══════════════╦════════════════════════════════════════════════════════════════════════════════════╗
// ║ 	 Биты  ║ Поле         ║                 Назначение                                                         ║
// ╠═════════╬══════════════╬════════════════════════════════════════════════════════════════════════════════════╣
// ║  31..12 ║      -       ║ Зарезервировано                                                                    ║
// ╟─────────╫──────────────╫────────────────────────────────────────────────────────────────────────────────────╢
// ║  11..8  ║PLLCPUMUL[3:0]║ Коэффициент умножения для CPU PLL                                                  ║
// ║         ║              ║ PLLCPUo = PLLCPUi x ( PLLCPUMUL+1)                                                 ║
// ╟─────────╫──────────────╫────────────────────────────────────────────────────────────────────────────────────╢
// ║   7..4  ║PLLUSBMUL[3:0]║ Коэффициент умножения для USB PLL                                                  ║
// ║         ║              ║ PLLUSBo = PLLUSBi x ( PLLUSBMUL+1)                                                 ║
// ╟─────────╫──────────────╫────────────────────────────────────────────────────────────────────────────────────╢
// ║    3    ║ PLLCPURLD    ║ Бит перезапуска CPU PLL                                                            ║
// ║         ║              ║ При смене коэффициента умножения в рабочем режиме необходимо задать равным 1, а    ║
// ║         ║              ║ после этого сбросить в 0.                                                          ║
// ╟─────────╫──────────────╫────────────────────────────────────────────────────────────────────────────────────╢
// ║    2    ║ PLLCPUON     ║ Бит включения CPU PLL                                                              ║
// ║         ║              ║ 0 - CPU PLL включена                                                               ║
// ║         ║              ║ 1 - CPU PLL отключена                                                              ║
// ╟─────────╫──────────────╫────────────────────────────────────────────────────────────────────────────────────╢
// ║    1    ║ PLLUSBRLD    ║ Бит перезапуска USB PLL                                                            ║
// ║         ║              ║ При смене коэффициента умножения в рабочем режиме необходимо задать равным 1, а    ║
// ║         ║              ║ после этого сбросить в 0.                                                          ║
// ╟─────────╫──────────────╫────────────────────────────────────────────────────────────────────────────────────╢
// ║    0    ║ PLLCPUON     ║ Бит включения USB PLL                                                              ║
// ║         ║              ║ 0 - USB PLL включена                                                               ║
// ║         ║              ║ 1 - USB PLL отключена                                                              ║
// ╚═════════╩══════════════╩════════════════════════════════════════════════════════════════════════════════════╝		

	while((RST_CLK->CLOCK_STATUS&0x02)!=0x02);		//wait until PLL CPU not ready
	RST_CLK->PER_CLOCK|=0x08;							//EEPROM_CNTRL Clock enable
	EEPROM ->CMD=4<<3;											//Delay=4	 
	RST_CLK->PER_CLOCK&=(~0x08);					//EEPROM_CNTRL Clock enable (disable???)
	
			//CPU Clock = 12*8MHz = 96 MHz

 
RST_CLK->CPU_CLOCK |= (1<<2); //Биты выбора источника для CPU_C2 : 1 – PLLCPUo

//----Биты выбора источника для HCLK :  01 – CPU_C3 --------------------
RST_CLK->CPU_CLOCK |= (1<<8); //установка еденицы
RST_CLK->CPU_CLOCK &=~(1<<9); //установка нуля
//----------------------------------------------------------------------

//---- Биты выбора делителя для CPU_C3: 0xxx – CPU_C3 = CPU_C2 ---------
RST_CLK->CPU_CLOCK &=~(0x0f<<4); //установка нуля для 4-х разрядов
RST_CLK->CPU_CLOCK |= (0x00<<4); //установка требуемого значения = 0x00
//----------------------------------------------------------------------


	RST_CLK->ETH_CLOCK=(1<<24)|(3<<28)|(1<<27);		//PHY_CLK_SEL = HSE2, ETH_CLK_EN=1, PHY_CLK_EN=1, ETH_CLK = 25MHz
	// RST_CLK->ETH_CLOCK - Регистр управления таковой частотой Ethernet и ГОСТ Р 52070-2003
// ╔═════════╦════════════════╦════════════════════════════════════════════════════════════════════════════════════╗
// ║ 	 Биты  ║ Поле           ║                 Назначение                                                         ║
// ╠═════════╬════════════════╬════════════════════════════════════════════════════════════════════════════════════╣
// ║  31..30 ║      -         ║ Зарезервировано                                                                    ║
// ╟─────────╫────────────────╫────────────────────────────────────────────────────────────────────────────────────╢
// ║  29..28 ║PHY_CLK_SEL[1:0]║ Биты выбора источника частоты для Ethernet PHY                                     ║
// ║         ║                ║ 00 - HSI                                                                           ║
// ║         ║                ║ 01 - HSE                                                                           ║
// ║         ║                ║ 10 - PLLCPUo                                                                       ║
// ║         ║                ║ 11 - HSE2 с ревизии 2                                                              ║
// ╟─────────╫────────────────╫────────────────────────────────────────────────────────────────────────────────────╢
// ║   27    ║ PHYCLKEN       ║ Разрешение тактовой частоты Ethernet PHY                                           ║
// ║         ║                ║ 0 - нет частоты                                                                    ║
// ║         ║                ║ 1 - есть частота                                                                   ║
// ╟─────────╫────────────────╫────────────────────────────────────────────────────────────────────────────────────╢
// ║   26    ║ SLEEP          ║ Перевод ядра контроллера в режим пониженного электропотребления                    ║
// ║         ║                ║ 0 - рабочий режим                                                                  ║
// ║         ║                ║ 1 - режим пониженного электропотребления                                           ║
// ║         ║                ║ В этом режиме тактовая частота поступает только на выбранные периферийные блоки,   ║
// ║         ║                ║ прерывание от которых возобновляет подачу тактовой частоты на процессорное ядро    ║
// ╟─────────╫────────────────╫────────────────────────────────────────────────────────────────────────────────────╢
// ║   25    ║ MANCLKEN       ║ Разрешение тактовой частоты на контроллер ГОСТ Р 52070-2003                        ║
// ║         ║                ║ 0 - нет частоты                                                                    ║
// ║         ║                ║ 1 - есть частота                                                                   ║
// ╟─────────╫────────────────╫────────────────────────────────────────────────────────────────────────────────────╢
// ║   24    ║ ETHCLKEN       ║ Разрешение тактовой частоты на Ethernet MAC                                        ║
// ║         ║                ║ 0 - нет частоты                                                                    ║
// ║         ║                ║ 1 - есть частота                                                                   ║
// ╟─────────╫────────────────╫────────────────────────────────────────────────────────────────────────────────────╢
// ║ 23..16  ║ PHYBRG[7:0]    ║ Делитель тактовой частоты PHY                                                      ║
// ║         ║                ║ xxxxx000 - PHY_CLK = PHY1_CLK                                                      ║
// ║         ║                ║ xxxxx001 - PHY_CLK = PHY1_CLK/2                                                    ║
// ║         ║                ║ xxxxx010 - PHY_CLK = PHY1_CLK/4                                                    ║
// ║         ║                ║ xxxxx011 - PHY_CLK = PHY1_CLK/8                                                    ║
// ║         ║                ║ ...                                                                                ║
// ║         ║                ║ xxxxx111 - PHY_CLK = PHY1_CLK/128                                                  ║
// ╟─────────╫────────────────╫────────────────────────────────────────────────────────────────────────────────────╢
// ║ 15..8   ║ MANBRG[7:0]    ║ Делитель тактовой частоты контроллера ГОСТ Р 52070-2003                            ║
// ║         ║                ║ xxxxx000 - MAN_CLK = HCLK                                                          ║
// ║         ║                ║ xxxxx001 - MAN_CLK = HCLK/2                                                        ║
// ║         ║                ║ xxxxx010 - MAN_CLK = HCLK/4                                                        ║
// ║         ║                ║ xxxxx011 - MAN_CLK = HCLK/8                                                        ║
// ║         ║                ║ ...                                                                                ║
// ║         ║                ║ xxxxx111 - MAN_CLK = HCLK/128                                                      ║
// ╟─────────╫────────────────╫────────────────────────────────────────────────────────────────────────────────────╢
// ║  7..0   ║ ETHBRG[7:0]    ║ Всегда задавать 0                                                                  ║
// ╚═════════╩════════════════╩════════════════════════════════════════════════════════════════════════════════════╝
#else
	RST_CLK->HS_CONTROL=0x00000003;					//HSE - On; Gen mode On
	while((RST_CLK->CLOCK_STATUS&0x04)!=0x04);		//Wait until HSE not ready
	RST_CLK->CPU_CLOCK=0x00000003;					//HSE/2 = 12.5 MHz
	RST_CLK->PLL_CONTROL=(7<<8)|(1<<2);				//PLL CPU On;
	while((RST_CLK->CLOCK_STATUS&0x02)!=0x02);		//wait until PLL CPU not ready
	RST_CLK->PER_CLOCK|=0x08;						//EEPROM Clock enable
	EEPROM ->CMD=4<<3;								//Delay = 4	 
	RST_CLK->CPU_CLOCK |= 0x00000107;				//CPU Clock = 8*12.5MHz = 100 MHz
	RST_CLK->ETH_CLOCK=(1<<24)|(1<<28)|(1<<27);		//PHY_CLK_SEL = HSE, ETH_CLK_EN=1, PHY_CLK_EN=1, ETH_CLK = 25MHz
#endif	//REVISION_2
// RST_CLK->CAN_CLOCK = (3<<24) | ( 3<<8 ) | 3;
// RST_CLK->CAN_CLOCK - Регистр управления тактовой частотой CAN
// ╔═════════╦════════════════╦════════════════════════════════════════════════════════════════════════════════════╗
// ║ 	 Биты  ║ Поле           ║                 Назначение                                                         ║
// ╠═════════╬════════════════╬════════════════════════════════════════════════════════════════════════════════════╣
// ║  31..26 ║      -         ║ Зарезервировано                                                                    ║
// ╟─────────╫────────────────╫────────────────────────────────────────────────────────────────────────────────────╢
// ║   25    ║ CAN2CLKEN      ║ Разрешение тактовой частоты на CAN2                                                ║
// ║         ║                ║ 0 - нет частоты                                                                    ║
// ║         ║                ║ 1 - есть частота                                                                   ║
// ╟─────────╫────────────────╫────────────────────────────────────────────────────────────────────────────────────╢
// ║   24    ║ CAN1CLKEN      ║ Разрешение тактовой частоты на CAN1                                                ║
// ║         ║                ║ 0 - нет частоты                                                                    ║
// ║         ║                ║ 1 - есть частота                                                                   ║
// ╟─────────╫────────────────╫────────────────────────────────────────────────────────────────────────────────────╢
// ║  23..16 ║      -         ║ Зарезервировано                                                                    ║
// ╟─────────╫────────────────╫────────────────────────────────────────────────────────────────────────────────────╢
// ║  15..8  ║  CAN2BRG[7:0]  ║ Делитель тактовой частоты CAN2                                                     ║
// ║         ║                ║ xxxxx000 - CAN2_CLK = HCLK                                                         ║
// ║         ║                ║ xxxxx001 - CAN2_CLK = HCLK/2                                                       ║
// ║         ║                ║ xxxxx010 - CAN2_CLK = HCLK/4                                                       ║
// ║         ║                ║ xxxxx011 - CAN2_CLK = HCLK/8                                                       ║
// ║         ║                ║ ...                                                                                ║
// ║         ║                ║ xxxxx111 - CAN2_CLK = HCLK/128                                                     ║
// ╟─────────╫────────────────╫────────────────────────────────────────────────────────────────────────────────────╢
// ║  7..0   ║  CAN1BRG[7:0]  ║ Делитель тактовой частоты CAN1                                                     ║
// ║         ║                ║ xxxxx000 - CAN1_CLK = HCLK                                                         ║
// ║         ║                ║ xxxxx001 - CAN1_CLK = HCLK/2                                                       ║
// ║         ║                ║ xxxxx010 - CAN1_CLK = HCLK/4                                                       ║
// ║         ║                ║ xxxxx011 - CAN1_CLK = HCLK/8                                                       ║
// ║         ║                ║ ...                                                                                ║
// ║         ║                ║ xxxxx111 - CAN1_CLK = HCLK/128                                                     ║
// ╚═════════╩════════════════╩════════════════════════════════════════════════════════════════════════════════════╝

	RST_CLK->PER_CLOCK|=			//		(1<< 5)|  //DMA
											(1<< 6)|  //UART1
											(1<< 7)|  //UART2
									//		(1<< 8)|  //SPI1
									//		(1<<14)|  //TIMER1
									//		(1<<15)|  //TIMER2
									//		(1<<16)|  //TIMER3
											(1<<17)|  //ADC1
									//		(1<<19)|  //TIMER4
									//		(1<<20)|  //SPI2
									  		(1<<21)|  //PORTA
											(1<<22)|  //PORTB
									  		(1<<23)|  //PORTC
											(1<<24)|  //PORTD
									        (1<<25)|  //PORTE
											(1<<29);  //PORTF; 			//Enable clock 
								    //		(1<<31);  //SPI3

	RST_CLK->UART_CLOCK =(0x2<<8)|          //Делитель тактовой частоты UART 2 HCLK/2
						 (0x2<<0)|          //Делитель тактовой частоты UART 1 HCLK/2
						 ( 1<<24)|          //enable CLK of UART1	
						 ( 1<<25);  		//enable CLK of UART2	

    RST_CLK->ADC_MCO_CLOCK  = 0x00000000;//обнуление регистра
	RST_CLK->ADC_MCO_CLOCK |= ( 2<< 0) //Биты выбора источника для ADC_C1 00 – CPU_C1 01 – USB_C1 10 – CPU_C2 11 – USB_C2
							 |( 2<< 4) //Биты выбора источника для ADC_C2 00 – LSE 01 – LSI 10 – ADC_C1 11 – HSI_C1 
							 |(15<< 8) //Биты выбора делителя для ADC_C3 0xxx – ADC_C3 = ADC_C2; 1000 – ADC_C3 = ADC_C2 / 2; 1001 – ADC_C3 = ADC_C2 / 4; 1010 – ADC_C3 = ADC_C2 / 8; …1111 – ADC_C3 = ADC_C2 / 256;
							 |( 1<<13); //Бит разрешения выдачи тактовой частоты ADC CLK 0 – запрещен 1 – разрешен 
							 
							 
}

#endif // __RST_CLK_c__
